/*
					*** 24c02_c文件 ***
| 适配硬件:| HL-1开发板
===========================================================*/

#include "public.h"

/***********************************************************|
| 名称	:| 延时10ms
| 参数	:| 无
| 返回值	:| 无
/***********************************************************/
void delay10ms()		//@11.0592MHz
{
	unsigned char i, j;

	i = 18;
	j = 235;
	do
	{
		while (--j);
	} while (--i);
}


/***********************************************************|
| 描述	:| 字节写操作向24c02写入一个字节数据
| 参数1	:| u8 addr1	-24C02器件地址
| 参数2	:| u8 addr2	-24C02内部存储单元地址
| 参数3	:| u8 dat	-要往24C02存储的一个字节数据
| 返回值	:| 无
/***********************************************************/
void iic_Write_dat(u8 addr1, u8 addr2, u8 dat)
{
	bit ack = 0;
	
	iic_start();								//产生起始信号
	
	ack = iic_write_byte(addr1);				//寻址24c02
	if (ack)									//如果24C02未应答
		goto lable;								//就跳转
	
	ack = iic_write_byte(addr2);				//访问24C02内部存储单元
	if (ack)									//如果24C02未应答
		goto lable;								//就跳转
	
	ack = iic_write_byte(dat);					//向24C02内部单元写入数据
	if (ack)									//如果24C02未应答
		goto lable;								//就跳转
	
	lable:										//跳转标签
	iic_stop();									//发送停止信号
	if (ack)									//如果24C02未应答
	{
		lcd12864_show_str(0,0, "写");			//在Lcd12864屏幕第3行输出提示信息
		lcd12864_show_str(7,0, "!!");			//在Lcd12864屏幕第4行输出提示信息
	}
	delay10ms();								//延时10ms
}  


/***********************************************************|
| 描述	:| 字节读操作从24c02读取一个字节数据
| 参数1	:| u8 addr1	-24C02器件地址
| 参数2	:| u8 addr2	-24C02内部存储单元地址
| 返回值	:| u8 dat	-由24C02读取到的一个字节数据
/***********************************************************/ 
//u8 iic_read_dat(u8 addr1, u8 addr2)
//{
//	bit ack = 0;
//	u8 dat;
//	
//	iic_start();								//产生起始信号
//	
//	ack = iic_write_byte(addr1);				//寻址24c02
//	if (ack)									//如果24C02未应答
//		goto lable;								//就跳转
//	
//	ack = iic_write_byte(addr2);				//访问24C02内部存储单元
//	if (ack)									//如果24C02未应答
//		goto lable;								//就跳转
//	
//	iic_start();								//再次产生起始信号
//	
//	ack = iic_write_byte(addr1 | 0x01);			//寻址器件设置读取
//	if (ack)									//如果24C02未应答
//		goto lable;								//就跳转
//	
//	dat = iic_read_byte();						//读取24C02内部单元一个字节的数据
//	
//	iic_master_ackOrNack(0);					//向24C02发送非应答信号
//	
//	lable:										//跳转标签
//	iic_stop();									//产生停止信号	
//	if (ack)									//如果24C02未应答
//	{
//		lcd12864_show_str(0,0, "读");			//在Lcd12864屏幕第3行输出提示信息
//		lcd12864_show_str(7,0, "!!");			//在Lcd12864屏幕第4行输出提示信息
//		return 0;								//结束本函数，返回0
//	}
//	
//	return dat;									//成功读取后返回读取到的一个字节数据
//}


/***********************************************************|
| 描述	:| 页写操作往24c02连续写入n个字节数据(可跨页,n可大于8)
| 参数1	:| u8 addr1	-24C02器件地址
| 参数2	:| u8 addr2	-24C02内部存储单元的起始地址
| 参数3	:| u8 *pdat	-待写数据的指针
| 参数4	:| u8 len	-待写数据字节的数量
| 返回值	:| 无
/***********************************************************/ 
//void iic_write_page(u8 addr1, u8 addr2, u8 *pdat, u8 len)
//{
//	bit ack = 0;
//	
//	while (len > 0)
//	{
//		iic_start();							//产生起始信号
//		ack = iic_write_byte(addr1);			//寻址24c02
//		if (ack)								//如果24C02未应答
//			goto lable;							//就跳至lable处
//		
//		ack = iic_write_byte(addr2);			//访问24C02内部存储单元起始地址
//		if (ack)								//如果24C02未应答
//			goto lable;							//就跳至lable处
//		
//		while (len > 0)
//		{
//			ack = iic_write_byte(*pdat++);		//向24C02内部单元连续写入n个字节的数据
//			if (ack)							//如果24C02未应答
//				goto lable;						//就跳至lable处
//			
//			len--;
//			addr2++;							//每次写入一个字节，内存地址+1
//			if ((addr2 & 0x07) == 0)			//如果地址到达边界(判断新地址后三位是否为0)
//			{
//				break;							//就跳出循环	
//			}				
//		}
//		
//		lable:
//		iic_stop();								//发送停止信号
//		if (ack)								//如果24C02未应答
//		{
//			lcd12864_show_str(0,0, "写");		//在Lcd12864屏幕第3行输出提示信息
//			lcd12864_show_str(7,0, "!!");		//在Lcd12864屏幕第4行输出提示信息
//			len = 0;							//让len为0，可以结束内外循环
//		}
//		else
//		{
//			delay10ms();						//延时10ms
//		}		
//	}	
//}


/***********************************************************|
| 描述	:| 页读操作从24c02连续读取n个字节数据(n可大于8)
| 参数1	:| u8 addr1	-24C02器件地址
| 参数2	:| u8 addr2	-24C02内部存储单元的起始地址
| 参数3	:| u8 *pdat	-存储读取数据数组的指针
| 参数4	:| u8 len	-待读到数据字节的数量
| 返回值	:| 无
/***********************************************************/
//void iic_read_page(u8 addr1, u8 addr2, u8 *pdat, u8 len)
//{
//	bit ack = 0;
//	
//	iic_start();							//产生起始信号
//	ack = iic_write_byte(addr1);			//寻址24c02
//	if (ack)								//如果24C02未应答
//		goto lable;							//就跳至lable处
//	
//	ack = iic_write_byte(addr2);			//访问24C02内部存储单元起始地址
//	if (ack)								//如果24C02未应答
//		goto lable;							//就跳至lable处
//	
//	iic_start();							//再次产生起始信号
//	
//	ack = iic_write_byte(addr1 | 0x01);		//寻址器件设置读取
//	if (ack)								//如果24C02未应答
//		goto lable;							//就跳转
//	
//	while (len > 0)
//	{
//		*pdat++ = iic_read_byte();	 		//连续读取24C02内部单元len个字节的数据
//		if (len > 1)
//			iic_master_ackOrNack(1);		//主机应答24c02
//		else
//			iic_master_ackOrNack(0);		//主机对24c02发送非应答,结束读取
//		len--;								//读取数据字节数量-1
//	}
//	
//	lable:
//	iic_stop();								//发送停止信号
//	if (ack)								//如果24C02未应答
//	{
//		lcd12864_show_str(0,0, "读");		//在Lcd12864屏幕第3行输出提示信息
//		lcd12864_show_str(7,0, "!!");		//在Lcd12864屏幕第4行输出提示信息
//	}
//}


///**********************************************/
//// 名称			: IIC多字节写入(可跨页)
//// 参数u8 addr1	: 寻址从机的地址
//// 参数u8 addr2	: 从机内部存放数据地址
//// 参数u8 *p		: 指向要存放数据的指针
//// 参数u8 len	: 存放的数据长度
//// 返回值		: 无
///**********************************************/
//void iic_write_page(u8 addr1, u8 addr2, u8 *p, u8 len)
//{
//	bit ack;
//	
//	while (len > 0)
//	{
//		iic_start();					//向IIC总线产生起始信号
//		ack = iic_write_byte(addr1);			//寻址器件
//		if (ack)						//处理从机器应答
//		{
//			goto lable;					//非应答，就跳转
//		}
//		
//		ack = iic_write_byte(addr2);			//写入从机内部存放数据地址
//		if (ack)						//处理从机器应答
//		{
//			goto lable;					//非应答，就跳转
//		}
//		
//		while (len > 0)					//如果还有没写好的字节数
//		{
//			ack = iic_write_byte(*p++);		//每写入一个字节
//			if (ack)					//处理从机器应答
//			{
//				goto lable;				//非应答，就跳转
//			}
//			len--;						//写入字节数-1
//			addr2++;					//写入字节地址+1
//			if ((addr2 & 0x07) == 0)	//如果地址到达边界(判断新地址后三位是否为0)
//			{			
//				break;					//跳出当前循环
//			}					
//		}
//		
//		lable:
//		iic_stop();						//写完一页发送停止位
//		if (ack)
//		{
//			lcd12864_show_str(0,0, "写");		//在Lcd12864屏幕第3行输出提示信息
//			lcd12864_show_str(7,0, "!!");		//在Lcd12864屏幕第4行输出提示信息
//			len = 0;
//		}
//		else
//		{
//			delay10ms();				//延时10ms，等待从机从缓存将一页数据送入掉电保存区
//		}
//	}
//}


///**********************************************/
//// 名称			: IIC多字节读取(可跨页)
//// 参数u8 addr1	: 从机本机地址
//// 参数u8 addr2	: 从机内部存放要读取数据的地址
//// 参数u8 *p		: 保存读取数据内存空间的指针
//// 参数u8 len	: 读取的数据长度
//// 返回值		: 无
///**********************************************/
//void iic_read_page(u8 addr1, u8 addr2, u8 *p, u8 len)
//{
//	bit ack;
//	
//	iic_start();						//IIC总线产生起始信号
//	ack = iic_write_byte(addr1);				//寻址从机
//	if (ack)							//处理从机器应答
//	{
//		goto lable;						//非应答，就跳转
//	}
//	
//	ack = iic_write_byte(addr2);				//写入从机内部存放数据地址
//	if (ack)							//处理从机器应答
//	{
//		goto lable;						//非应答，就跳转
//	}
//	
//	iic_start();						//IIC总线再次产生起始信号
//	ack = iic_write_byte(addr1 | 0x01);		//寻址从机并对从机设置读取
//	if (ack)							//处理从机器应答
//	{
//		goto lable;						//非应答，就跳转
//	}
//	
//	while (len > 0)
//	{
//		*p++ = iic_read_byte();			//读取一个字节
//		if (len > 1)					//如果读取的不是最后一个字节
//		{
//			iic_master_ackOrNack(1);	//主机发送应答
//		}
//		else							//如果读取的是最后一个字节
//		{
//			iic_master_ackOrNack(0);	//主机发送非应答
//		}
//		len--;							//读取字节数-1					
//	}
//			
//	lable:
//	iic_stop();							//发送停止位
//	if (ack)
//	{
//		lcd12864_show_str(0,0, "读");		//在Lcd12864屏幕第3行输出提示信息
//		lcd12864_show_str(7,0, "!!");		//在Lcd12864屏幕第4行输出提示信息
//	}
//}