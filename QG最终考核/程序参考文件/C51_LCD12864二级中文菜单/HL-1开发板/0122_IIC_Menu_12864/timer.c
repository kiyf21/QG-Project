/*
					*** 定时器_c文件 ***
| 适配硬件:| HL-1开发板
===========================================================*/

#include "public.h"

bit flag200ms = 0;		//200ms标志位
u8 t0rh, t0rl;			//定时器0高低字节缓存
u8 cntS = 0;			//秒计数变量
u8 cntM = 0;			//分计数变量
u8 cntH = 0;			//时计数变量

/***********************************************************|
| 名称	:| 定时器0初始化
| 参数	:| u16 us	- 定时时长us毫秒
| 返回值	:| 无
/***********************************************************/
void timer0_init(u16 us)
{
	u32 tmp;					//临时变量
	
	tmp = (11059200/12*us) / 1000000;		//计算定时us所需计数值
	tmp = 65536 - tmp;						//计算定时us所需重载值
	t0rh = tmp >> 8;						//将重载值拆分到定时器0高字节缓存
	t0rl = tmp;								//将重载值拆分到定时器0低字节缓存
	TH0 = t0rh;								//定时器0装初值
	TL0 = t0rl;
	
	TMOD = TMOD & 0xF0 | 0x01;				//保持定时器1设置不变，配置定时器0工作模式1
	ET0 = 1;								//开定时器0中断
	TR0 = 1;								//启动定时器0
}


/***********************************************************|
| 名称	:| 定时器0中断服务函数
| 参数	:| 无
| 返回值	:| 无
/***********************************************************/
void timer0() interrupt 1
{
	static u8 cnt = 0;						//中断计数变量
	static u8 cnt200ms = 0;					//200ms计数变量
	static u8 cntD = 60;
	
	TH0 = t0rh;								//进中断重装初值
	TL0 = t0rl;
	
	cnt++;
	if (cnt >= 200)							//200ms时间到
	{
		cnt = 0;
		flag200ms = 1;						//200ms标志位置1
		cnt200ms++;							//200ms计数+1
		if (cnt200ms >= 5)
		{
			cnt200ms = 0;
			
			//进入设置界面倒计时计数----------------------------------
			if (mLayer != 0)
			{
				cntD--;
				if (flag_keyAc)			//如果有任意按键动作
				{
					cntD = 60;			//计数回到初始值
					flag_keyAc = 0;		//任意按键动作标志位清零
				}
				if (cntD <= 0)			//如果计数倒计到0
				{
					cntD = 60;			//计数回到初始值
					flag_autoExit = 1;	//自动退出标志位置1
				}
			}
			
			//时分秒计数-----------------------------------------------
//			if (mLayer == 0)				//不在设置状态，才可下述计数
//			{					
//				cntS++;								//秒计数+1
//				if (cntS >= 60)						//60秒时间到
//				{
//					cntS = 0;
//					cntM++;							//分计数+1
//					if (cntM >= 60)					//60分钟时间到
//					{
//						cntM = 0;
//						cntH++;						//小时计数+1
//						if (cntH >= 24)				//24小时到
//						{
//							cntH = 0;
//						}
//					}
//				}
//			}
		}
	}
}