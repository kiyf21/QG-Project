/*
				*** IIC_12864中文菜单 ***
| 适配硬件:| HL-1开发板
 ============================================================		
 | 硬件		:| HL-1开发板									|
 | 时间		:| 2021年01月22日 ~ 2021年01月XX日				|
 | 功能1	:| IIC的巩固练习(在KST-51上)						|
 | 功能2	:| 12864中文液晶的巩固练习						|
 | 功能3	:| 在12864实现中文菜单的学习						|
 | 功能4	:| 通过串口接收开发板KST-51发送的信号				|
 | 功能5	:| 通过串口接收开发板KST-51发送按键码				|
 ============================================================
*/

#include "public.h"
bit flag_autoExit = 0;
u8 year = 0;
u8 month = 0;
u8 day = 0;
u8 week;


void StartScreen();						//显示启动屏幕
void time_str(u8, u8);					//时分秒转字符串在屏幕指定位置显示
void date_str();
void save_time_24c02();

/***********************************************************|
| 					====== 主函数 ======
************************************************************/
void main()
{
	year = 21;
	month = 01;
	day = 07;
	//关HL-1开发板上的数码管显示
	P26 = 1;
	P0 = 0x00;
	P26 = 0;
	
	EA = 1;					//开总中断
	uart_init(9600);		//初始化uart,配置通信波特率9600
	timer0_init(1000);		//初始化定时器0，定时1ms
	lcd12864_init();		//初始化lcd12864液晶
	StartScreen();
	
	while (1)
	{
		if (flagUartRx)
		{
			pro_uartRx();					//处理串口数据
			flagUartRx = 0;
		}  
		
		if (flag200ms && (mLayer == 0))
		{
			flag200ms = 0;
			time_str(0, 2);					//在屏幕第3行第1个字符处显示时分秒		
			date_str();						//在屏幕第4行第1个字符处显示年月日
		}
		
		if (flag_autoExit)					//无操作计时到达自动退出标志位置1时
		{
			exit_set();						//退出设置界面
			flag_autoExit = 0;				//将自动退出标志位清0
		}
	}
}


/***********************************************************|
| 描述	:| 显示启动屏幕
| 参数1	:| u8 x	-光标在屏幕横向位置(以16个像素点为一个单位)
| 参数2	:| u8 y	-光标在屏幕纵向位置(以16个像素点为一个单位)
| 返回值	:| 无
/***********************************************************/
void StartScreen()
{
    const u8 code welcome[] = {
        0x00, 0x00, 0x00, 0x00, 0x00, 0x00, 0x00, 0x00, 0x00, 0x00, 0x00, 0x00,
		0x00, 0x00, 0x00, 0x00, 0x00, 0x00, 0x00, 0x00, 0x00, 0x00, 0x00, 0x00,
		0x00, 0x00, 0x00, 0x00, 0x00, 0x00, 0x00, 0x00, 0x00, 0x00, 0x00, 0x00,
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		0x00, 0x00, 0x00, 0x00, 0x00, 0x00, 0x00, 0x00, 0x00, 0x00, 0x00, 0x00
    };
	lcd12864_clear_str(0, 0, 8);					//清除屏幕第一行8个汉字字符位
    lcd12864_show_img(1, 0, 96, 32, welcome);
//	lcd12864_show_str(4, 2, "菜单测试");
	lcd12864_show_str(0, 3, "20  年  月  日");
	lcd12864_show_str(5, 2, "星期");
}


/***********************************************************|
| 名称	:| 将一个字节在屏幕指定位置以十六进制显示
| 参数1	:| u8 x		-光标在屏幕横向位置(0-7共8个汉字位置)
| 参数2	:| u8 y		-光标在屏幕纵向位置(0-3共4个汉字位置)
| 参数3	:| u8 byte	-要显示的一个字节数据
| 返回值	:| 无
/***********************************************************/
void showHex_byte(u8 x, u8 y, u8 byte)
{
	u8 buf[3];
	
	//时高4位转字符------------------------------------|
	if ((byte >> 4) <= 9)
	{
		buf[0] = (byte >> 4) + '0';				 		//高4位转字符0-9
	}
	else
	{
		buf[0] = ((byte >> 4) - 10) + 'A';				//高4位转字符A-F
	}
	
	//时低4位转字符------------------------------------|
	if ((byte & 0x0F) <= 9)
	{
		buf[1] = (byte & 0x0F) + '0';					//低4位转字符0-9
	}
	else
	{
		buf[1] = ((byte & 0x0F) - 10) + 'A';			//低4位转字符A-F
	}

	buf[2] = '\0';										//添加结束符
	lcd12864_show_str(x, y, buf);						//在屏幕指定位置显示该十六进制数
}


/***********************************************************|
| 描述	:| 时分秒转字符串在屏幕指定位置显示
| 参数1	:| u8 x		- 屏幕区域横向坐标(以16个像素点为一个单位)
| 参数2	:| u8 y		- 屏幕区域纵向坐标(以16个像素点为一个单位)
| 返回值	:| 无
/***********************************************************/
void time_str(u8 x, u8 y)
{
	u8 buf[9];
	
	//时高4位转字符------------------------------------
	if ((cntH >> 4) <= 9)
	{
		buf[0] = (cntH >> 4) + '0';				 		//高4位转字符0-9
	}
	else
	{
		buf[0] = ((cntH >> 4) - 10) + 'A';				//高4位转字符A-F
	}
	
	//时低4位转字符
	if ((cntH & 0x0F) <= 9)
	{
		buf[1] = (cntH & 0x0F) + '0';					//低4位转字符0-9
	}
	else
	{
		buf[1] = ((cntH & 0x0F) - 10) + 'A';			//低4位转字符A-F
	}
	
	buf[2] = ':';										//添加间隔符
	
	//分高4位转字符------------------------------------
	if ((cntM >> 4) <= 9)
	{
		buf[3] = (cntM >> 4) + '0';				 		//高4位转字符0-9
	}
	else
	{
		buf[3] = ((cntM >> 4) - 10) + 'A';				//高4位转字符A-F
	}
	
	//分低4位转字符
	if ((cntM & 0x0F) <= 9)
	{
		buf[4] = (cntM & 0x0F) + '0';					//低4位转字符0-9
	}
	else
	{
		buf[4] = ((cntM & 0x0F) - 10) + 'A';			//低4位转字符A-F
	}
	
	buf[5] = ':';										//添加间隔符
	
	//秒高4位转字符------------------------------------
	if ((cntS >> 4) <= 9)
	{
		buf[6] = (cntS >> 4) + '0';				 		//高4位转字符0-9
	}
	else
	{
		buf[6] = ((cntS >> 4) - 10) + 'A';				//高4位转字符A-F
	}
	
	//秒低4位转字符
	if ((cntS & 0x0F) <= 9)
	{
		buf[7] = (cntS & 0x0F) + '0';					//低4位转字符0-9
	}
	else
	{
		buf[7] = ((cntS & 0x0F) - 10) + 'A';			//低4位转字符A-F
	}
	buf[8] = '\0';										//添加结束符
	lcd12864_show_str(x, y, buf);		//在屏幕横向坐标x,纵向坐标y处显示字符串
}


/***********************************************************						|
| 描述	:| 在屏幕指定位置显示年月日时分秒星期
| 参数	:| 无
| 返回值	:| 无
/***********************************************************/
void date_str()
{
	showHex_byte(1, 3, year);			//显示年份
	showHex_byte(3, 3, month);			//显示月份
	showHex_byte(5, 3, day);			//显示日
	
//	showHex_byte(0, 2, hour);			//显示小时
//	showHex_byte(2, 3, min);			//显示分钟
//	showHex_byte(4, 3, sec);			//显示秒

	switch (week)						//显示星期
	{
		case 0x01: lcd12864_show_str(7, 2, "一"); break;
		case 0x02: lcd12864_show_str(7, 2, "二"); break;
		case 0x03: lcd12864_show_str(7, 2, "三"); break;
		case 0x04: lcd12864_show_str(7, 2, "四"); break;
		case 0x05: lcd12864_show_str(7, 2, "五"); break;
		case 0x06: lcd12864_show_str(7, 2, "六"); break;
		case 0x07: lcd12864_show_str(7, 2, "日"); break;
		default: break;
	}
}