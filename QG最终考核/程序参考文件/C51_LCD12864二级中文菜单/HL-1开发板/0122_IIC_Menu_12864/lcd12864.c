/*
			*** lcd12864中文液晶_c文件 ***
| 适配硬件:| HL-1开发板
===========================================================*/

#include "public.h"

/***********************************************************|
| 名称	:| 检测液晶是否忙，等待液晶准备好
| 参数	:| 无
| 返回值	:| 无
/***********************************************************/
void lcd12864_wait_ready()
{
	u8 sta;						//液晶数据口状态
	
	DB = 0xFF;					//这句一定要记住不能少啊，否则液晶不显示内容
	RS = 0;						//选择指令
	RW = 1;						//选择读取
	do {
		E = 1;					//打开液晶使能端
		sta = DB;				//读取液晶数据并保存
		E = 0;					//关闭液晶使能端
	} while (sta & 0x80);		//判断读取的液晶数据bit7位是否为1(忙)，循环检测直到为0(不忙)为止
}


/***********************************************************|
| 名称	:| 往液晶写入一个字节的指令
| 参数	:| u8 cmd	-待写指令
| 返回值	:| 无
/***********************************************************/
void lcd12864_write_cmd(u8 cmd)
{
	lcd12864_wait_ready();			//等待液晶准备好
	RS = 0;							//选择指令
	RW = 0;							//选择写入
	E  = 1;							//打开液晶使能端
	DB = cmd;						//将待写指令送到液晶数据口，等待写入
	E  = 0;							//关闭液晶使能端，指令在下降沿时写入液晶
	delay100us();					//延时
}


/***********************************************************|
| 名称	:| 往液晶写入一个字节的数据
| 参数	:| u8 cmd	-待写数据
| 返回值	:| 无
/***********************************************************/
void lcd12864_write_dat(u8 dat)
{
	lcd12864_wait_ready();			//等待液晶准备好
	RS = 1;							//选择数据
	RW = 0;							//选择写入
	E  = 1;							//打开液晶使能端
	DB = dat;						//将待写数据送到液晶数据口，等待写入
	E  = 0;							//关闭液晶使能端，数据在下降沿时写入液晶
	delay100us();					//延时
}


/***********************************************************|
| 名称	:| 设置光标在液晶屏幕的位置
| 参数1	:| u8 x	-光标在屏幕横向位置(以16个像素点为一个单位)
| 参数2	:| u8 y	-光标在屏幕纵向位置(以16个像素点为一个单位)
| 返回值	:| 无
/***********************************************************/
void lcd12864_set_cursor(u8 x, u8 y)
{
	u8 addr;								//光标RAM地址
	
	switch (y)
	{
		case 0: addr = 0x80 + x; break;		//设置光标在屏幕第一行x位置汉字位
		case 1: addr = 0x90 + x; break;		//设置光标在屏幕第二行x位置汉字位
		case 2: addr = 0x88 + x; break;		//设置光标在屏幕第三行x位置汉字位
		case 3: addr = 0x98 + x; break;		//设置光标在屏幕第四行x位置汉字位
		default: break;
	}
	lcd12864_write_cmd(addr);				//将光标RAM地址作为指令写入液晶	
	delay100us();							//延时
}


/***********************************************************|
| 名称	:| 在屏幕指定位置显示字符串
| 参数1	:| u8 x		- 光标在屏幕横向位置(以16个像素点为一个单位)
| 参数2	:| u8 y		- 光标在屏幕纵向位置(以16个像素点为一个单位)
| 参数3	:| u8 *str	- 字符串内存单元的指针
| 返回值	:| 无
/***********************************************************/
void lcd12864_show_str(u8 x, u8 y, u8 *str)
{
	//由起始DDRAM地址连续写入字符串
	lcd12864_write_cmd(0x30);				//启动DDRAM操作
	lcd12864_set_cursor(x, y);				//指定显示字符串的屏幕位置	
	while (*str != '\0')					//检测到写入的字符是结束符\0时，结束写入
	{
		lcd12864_write_dat(*str++);			//连续往液晶写入字符
	}
}


/***********************************************************|
| 描述	:| 在屏幕指定位置清除字符串
| 参数1	:| u8 x		- 光标在屏幕横向位置(以16个像素点为一个单位)
| 参数2	:| u8 y		- 光标在屏幕纵向位置(以16个像素点为一个单位)
| 参数3	:| u8 n		- 要清除的字符个数
| 返回值	:| 无
/***********************************************************/
void lcd12864_clear_str(u8 x, u8 y, u8 n)
{
	u8 i;
	
	//由起始DDRAM地址连续写入字符串
	lcd12864_write_cmd(0x30);				//启动DDRAM操作
	lcd12864_set_cursor(x, y);				//指定显示字符串的屏幕位置	
	i = n * 2;
	while (i--)								//检测到清除的字符个数为0时，结束清除
	{
		lcd12864_write_dat(' ');			//连续往液晶写入2个英文字符空格的空格
	}
}


/***********************************************************|
| 名称	:| 在屏幕指定位置显示字符串
| 参数1	:| u8 x		- 屏幕区域横向坐标(以像素为单位)
| 参数2	:| u8 y		- 屏幕区域纵向坐标(以像素为单位)
| 参数3	:| u8 *str	- 待显示字符串的指针
| 返回值	:| 无
| 备  注	:| x,y必须是16的整数倍,因DDRAM的地址以全角字符(16*16pixel)为单位
/***********************************************************/
//void lcd12864_show_str(u8 x, u8 y, u8 *str)
//{
//	u8 addr;								//地DDRAM址变量
//	
//	//由输入的显示坐标计算DDRAM地址
//	x >>= 4;								//横向地址为2个字节16点傃素递值减，所以这里要将像素/16
//	y >>= 4;								//纵向地址为2个字节16点傃素递值减，所以这里要将像素/16
//	if (y >= 2)								//纵向地址汉显第一、三行相同，第二、四行相同，所以遇到
//	{										//三、四行依然取第一、二行的80和90地址
//		y -= 2;								//y=2时减2就是0，就是第一行的超始地址
//		x += 8;								//这里+8就是第三行的开始，第三行实际是接着第一行后面的，
//	}										//第一行是8个16像素，这里就+8
//	addr = y*16 + x;						//计算出光标DDARM地址
//	
//	//由起始DDRAM地址连续写入字符串
//	lcd12864_write_cmd(0x30);				//启动DDRAM操作
//	lcd12864_write_cmd(0x80 | addr);		//写入光标DDRAM地址
//	while (*str != '\0')
//	{
//		lcd12864_write_dat(*str++);			//连续往液晶写入字符
//	}
//}


/***********************************************************|
| 名称	:| 在屏幕指定位置显示一幅图像
| 参数1	:| u8 x		- 屏幕区域横向坐标(以16个像素点为一个单位)
| 参数2	:| u8 y		- 屏幕区域纵向坐标(以16个像素点为一个单位)
| 参数3	:| u8 w		- 图像宽度(以1个像素点为一个单位)
| 参数4	:| u8 h		- 图像高度(以1个像素点为一个单位)
| 参数5	:| u8 *img	- 待显示图像的指针 
| 返回值	:| 无
| 备  注	:| x与w必须是16的整数倍,因CGRAM最小寻址单位为2字节,y与h可为0-63的任意值。
/***********************************************************/
void lcd12864_show_img(u8 x, u8 y, u8 w, u8 h, u8 *img)
{
	u16 i = 0;								//图像数据字节个数索引
	u8 xi, yi;								//图像数据横向和纵向循环索引变量
	u8 xt, yt;								//图像GDRAM水平位址(0-F)和垂直位址(0-31)
	
	w >>= 3;								//图像宽度/8,就是图像横向数据个数
	lcd12864_write_cmd(0x36);				//启动GDRAM操作	
	for (yi=0; yi<h; yi++)					//循环图像垂直位址(每次一个像素)
	{
		yt = y*16 + yi;						//计算图像垂直位址(绘图模式垂直位址以位为单位)
		xt = x;								//计算图像水平位址(绘图模式水平位址以字节为单位)
		if (yt >= 32)						//当图像垂直位址大于31时，应该到下半屏了
		{
			yt -= 32;						//图像垂直位址减掉32(绘图模式垂直位址范围0-31)
			xt += 8;						//图像水平位址+8(绘图模式水平位址0-F，其中8-F是下半屏)
		}
		lcd12864_write_cmd(0x80 | yt);		//往液晶写入待写图像垂直位址(这个要先写，否则显示错乱)
		lcd12864_write_cmd(0x80 | xt);		//往液晶写入待写图像水平位址
		for (xi=0; xi<w; xi++)
		{
			lcd12864_write_dat(img[i++]);	//连续写入一个字节的图像数据
		}
	}
}


/***********************************************************|
| 名称	:| 清除屏幕上的一块图形显示区域
| 参数1	:| u8 x		- 屏幕区域横向坐标(以16个像素点为一个单位)
| 参数2	:| u8 y		- 屏幕区域纵向坐标(以16个像素点为一个单位)
| 参数3	:| u8 w		- 图像宽度(以1个像素点为一个单位)
| 参数4	:| u8 h		- 图像高度(以1个像素点为一个单位)
| 参数5	:| bit wb	- 图像反白标记，1反白显示，0正常显示
| 返回值	:| 无
| 备  注	:| x与w必须是16的整数倍,因CGRAM最小寻址单位为2字节,y与h可为0-63的任意值。
/***********************************************************/
void lcd12864_clear_area(u8 x, u8 y, u8 w, u8 h, bit wb)
{
	u8 xi;									//图像数据横向循环索引变量
	u8 yi;									//图像像素纵向循环索引变量
	u8 xt;									//图像GDRAM水平位址(0-F)
	u8 yt;									//图像GDRAM垂直位址(0-31)
	
	w >>= 3;								//图像宽度/8,就是图像横向数据个数
	lcd12864_write_cmd(0x36);				//启动GDRAM操作
	for (yi=0; yi<h; yi++)					//循环图像垂直位址(每次一个像素)
	{
		yt = y*16 + yi;						//计算图像垂直位址(绘图模式垂直位址以位为单位)
		xt = x;								//计算图像水平位址(绘图模式水平位址以字节为单位)
		if (yt >= 32)						//当图像垂直位址大于31时，应该到下半屏了
		{
			yt -= 32;						//图像垂直位址减掉32(绘图模式垂直位址范围0-31)
			xt += 8;						//图像水平位址+8(绘图模式水平位址0-F，其中8-F是下半屏)
		}
		lcd12864_write_cmd(0x80 | yt);		//往液晶写入待写图像垂直位址(这个要先写，否则显示错乱)
		lcd12864_write_cmd(0x80 | xt);		//往液晶写入待写图像水平位址
		for (xi=0; xi<w; xi++)
		{
			if (wb)
			{
				lcd12864_write_dat(0xFF);	//向屏幕区域写入反白清屏数据
			}
			else
			{
				lcd12864_write_dat(0x00);	//向屏幕区域写入正常清屏数据
			}
		}
	}
}


/***********************************************************|
| 描述	:| 反白屏幕指定位置的半个字符位(不能清除文字)
| 参数1	:| u8 x		- 屏幕区域横向坐标(以16个像素点为一个单位)
| 参数2	:| u8 y		- 屏幕区域纵向坐标(以16个像素点为一个单位)
| 参数5	:| bit lr	- 左/右半角字符位标志，0左半角，1右半角
| 返回值	:| 无
/***********************************************************/
//void lcd12864_clear_char(u8 x, u8 y, bit lr)
//{
//	u8 xi;									//图像数据横向循环索引变量
//	u8 yi;									//图像像素纵向循环索引变量
//	u8 xt;									//图像GDRAM水平位址(0-F)
//	u8 yt;									//图像GDRAM垂直位址(0-31)
//	
//	lcd12864_write_cmd(0x36);				//启动CGRAM操作
//	for (yi=0; yi<16; yi++)					//循环图像垂直位址(每次一个像素)
//	{
//		yt = y*16 + yi;						//计算图像垂直位址(绘图模式垂直位址以位为单位)
//		xt = x;
//		if (yt >= 32)						//当图像垂直位址大于31时，应该到下半屏了
//		{
//			yt -= 32;						//图像垂直位址减掉32(绘图模式垂直位址范围0-31)
//			xt += 8;						//图像水平位址+8(绘图模式水平位址0-F，其中8-F是下半屏)
//		}
//		lcd12864_write_cmd(0x80 | yt);		//往液晶写入待写图像垂直位址(这个要先写，否则显示错乱)
//		lcd12864_write_cmd(0x80 | xt);		//往液晶写入待写图像水平位址
//		for (xi=0; xi<2; xi++)
//		{
//			if (((xi==0) &&  lr) || ((xi==1) && (lr==0)))
//			{
//				lcd12864_write_dat(0x00);							//向屏幕区域写入正常清屏数据
//			}
//			else if (((xi==1) && lr) || ((xi==0) && (lr==0)))
//			{
//				lcd12864_write_dat(0xFF);							//向屏幕区域写入反白清屏数据
//			}
//		}
//	}
//}


/***********************************************************|
| 名称	:| lcd12864液晶初始化
| 参数	:| 无
| 返回值	:| 无
/***********************************************************/
void lcd12864_init()
{
	u8 x, y;
	
	//字符模式实始化
	lcd12864_write_cmd(0x30);				//基本指令集
	delay5ms();
	lcd12864_write_cmd(0x01);				//清零字符显示
	delay5ms();
	lcd12864_write_cmd(0x02);				//地址归位
	lcd12864_write_cmd(0x0C);				//显示开，光标不显示
	
	//图形模式初始化
	lcd12864_write_cmd(0x34);				//启动扩展指令，关闭图形显示
	for (y=0; y<32; y++)					//清零图形显示缓冲区
	{
		lcd12864_write_cmd(0x80 | y);
		lcd12864_write_cmd(0x80 | 0);
		for (x=0; x<32; x++)
		{
			lcd12864_write_dat(0x00);
		}
	}
//	lcd12864_write_cmd(0x36);				//开启图形显示(可以省略，因为绘图时会启动GDRAM操作)
}


/***********************************************************|
| 名称	:| 将一个字节的数据在液晶指定位置以十进制显示
| 参数1	:| u8 x		-光标在屏幕横向位置(0-7共8个汉字位置)
| 参数2	:| u8 y		-光标在屏幕纵向位置(0-3共4个汉字位置)
| 参数3	:| u8 byte	-要显示的一个字节数据
| 返回值	:| 无
/***********************************************************/
void showDec_byte(u8 x, u8 y, u8 dat)
{
	u8 buf[3];
	
	buf[0] = dat / 10 + '0';		//将数据对10取模+字符0放入数组第一个元素
	buf[1] = dat % 10 + '0';		//将数据对10取余+字符0存入数组第二个元素
	buf[2] = '\0';					//添加结束符
	lcd12864_show_str(x, y, buf);	//在屏幕x,y位置显示该十进制数
}


/***********************************************************|
| 名称	:| 将一个长整型数转字符串在屏幕指定位置显示
| 参数1	:| u8 x		-光标在屏幕横向位置(0-7共8个汉字位置)
| 参数2	:| u8 y		-光标在屏幕纵向位置(0-3共4个汉字位置)
| 参数3	:| signed long *pNum	-要显示的长整型数
| 返回值	:| 无
/***********************************************************/
//void long_str(u8 x, u8 y, signed long *pNum)
//{
//	u8 i = 0;						//用于数组缓冲区的下标
//	u8 j, k;						//用于数组互换位置的循环变量
//	u8 buf[12];						//转换字符串缓冲区
//	signed long tmp;				//保存长整型数的临时变量
//	
//	tmp = *pNum;					//将待转长整型放入缓冲区
//	if (tmp < 0)					//如果长整型数为负数
//	{
//		tmp = -tmp;					//取其绝对值
//		buf[i++] = '-';				//添加负号
//	}
//	
//	do {
//		buf[i++] = tmp % 10 + '0';
//		tmp /= 10;
//	} while (tmp > 0);				//将长整型数分解为字符存入缓冲区
//	
//	if (buf[0] == '-')				//如果数组第一个元素是负号
//		j = 1;						//让j=1,即在数组元素互换位置时，第一个负号元素不互换
//	else							//如果第一个元素不是负号
//		j = 0;						//让j=0，从第一个元素开始互换位置

//	k = i - 1;						//元素下标的最大数为元素个数-1
//	while (j < k) 					//该循环实现数组内元素首尾互换位置
//	{
//		tmp = buf[j];
//		buf[j] = buf[k];
//		buf[k] = tmp;
//		j++;
//		k--;
//	}
//	buf[i] = '\0';					//最后添加结束符
//	
//	lcd12864_show_str(x, y, buf);	//在屏幕横向x，纵向y位置处显示该长整型数	
//}