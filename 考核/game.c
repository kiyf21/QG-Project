#include "pubilc.h"

typedef enum {
	KEY_CHOOSE,
	KEY_PLANT,
	KEY_REMOVE
} GameState;


GameState now_state_1 = KEY_CHOOSE; 

u8 Position = 11;
u8 Last_Position = 11;
u8 Type_Plant = 0;



static void Show_Position(u8 Position,u8 code *DData);
static void Chosen_Position(u8 key);
static void Type_Plant_Key(u8 key);
void Select_Plot(u8 Last_Position,u8 Position);


code unsigned char IMG_DATA_Position[32] = 
{
    0x00,0x00,0x00,0x00,0x00,0x00,0x00,0x00,0x00,0x00,0x00,0x00,0x01,0x80,0x03,0xC0,
    0x03,0xC0,0x01,0x80,0x00,0x00,0x00,0x00,0x00,0x00,0x00,0x00,0x00,0x00,0x00,0x00,/*' ',0*/
};

code unsigned char IMG_DATA_Empty[32] = 
{
    0x00,0x00,0x00,0x00,0x00,0x00,0x00,0x00,0x00,0x00,0x00,0x00,0x00,0x00,0x00,0x00,
    0x00,0x00,0x00,0x00,0x00,0x00,0x00,0x00,0x00,0x00,0x00,0x00,0x00,0x00,0x00,0x00,
};

code unsigned char IMG_DATA2_Plant[32] = 
{
    0x00,0x00,0x18,0x00,0x39,0xE0,0x70,0xF2,0x30,0xCE,0x30,0x0E,0x30,0x0E,0x0C,0x3E,
    0x07,0xC0,0x02,0x00,0x00,0x00,0x00,0x00,0x0F,0x80,0x0F,0xE0,0x1F,0xE0,0x0C,0x00,
};

code unsigned char IMG_DATA_map[1024] = 
{
    0xFF,0xFF,0xFF,0xFF,0xFF,0xFF,0xFF,0xFF,0xFF,0xFF,0xFF,0xFF,0xFF,0xFF,0xFF,0xFF,
    0x80,0x00,0x00,0x00,0x00,0x00,0x00,0x00,0x00,0x00,0x00,0x00,0x00,0x00,0x00,0x01,
    0x80,0x00,0x00,0x00,0x00,0x00,0x00,0x00,0x00,0x00,0x00,0x00,0x00,0x00,0x00,0x01,
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    0xFF,0xFF,0xFF,0xFF,0xFF,0xFF,0xFF,0xFF,0xFF,0xFF,0xFF,0xFF,0xFF,0xFF,0xFF,0xFF,
};


code unsigned char IMG_DATA_Person[32] = 
{
    0x01,0xC0,0x06,0x38,0x30,0x0C,0x60,0x04,0x46,0x67,0x40,0xB2,0x71,0x0A,0x49,0x6A,
    0x4B,0x10,0x70,0xE6,0x3E,0x01,0x0F,0x88,0x0D,0xD0,0x18,0x34,0x09,0xD4,0x01,0x14,
};

code unsigned char IMG_DATA_Pototas[32] = 
{
    0x07,0xC0,0x1C,0x30,0x28,0x08,0x08,0x04,0x53,0x1E,0x54,0xA2,0x94,0x97,0x82,0x89,
    0xA0,0x01,0xA0,0x01,0xA0,0x01,0x80,0x01,0x50,0x02,0x30,0x06,0x18,0x0C,0x07,0xF0,
};








// ====================== 游戏主逻辑 ======================
void Game_Main(void)
{
	u8 key_1;
	u8 last_state_1 = 0xFF; // 记录上一状态，用于自动刷新
	
	
	LCD12864_Init();
	Delay_ms(400);
	
	LCD12864_Clear();
	LCD12864_Show_Image(IMG_DATA_map);
	LCD12864_Show_String(3,0,"Round:");
	LCD12864_Show_Onechar(0,0,0x24);
	Show_Position(Position,IMG_DATA_Position);
    while(1)
    {
		
        key_1 = MatrixKey();
        if(key_1 == 0) continue;
        switch(now_state_1)
        {
            case KEY_CHOOSE:  Chosen_Position(key_1);   break;
            case KEY_PLANT:   Type_Plant_Key(key_1);    break;
        }
		
    }
}

//按键控制游标上下移动
static void Chosen_Position(u8 key)
{
    if(key == 2) // 上
    {
        if(Position/10!=1)
		{
			Last_Position = Position;
			Position=Position-10;
		}
		Select_Plot(Last_Position,Position);
		
    
	}
    if(key == 10) // 下
    {
        if(Position/10!=3)
		{
			Last_Position = Position;
			Position=Position+10;
		}
		Select_Plot(Last_Position,Position);
	}
	if(key == 5) //左
    {
        if(Position%10!=1)
		{
			Last_Position = Position;
			Position=Position-1;
		}
		Select_Plot(Last_Position,Position);
    }
    if(key == 7) //右
    {
        if(Position%10!=2)
		{
			Last_Position = Position;
			Position=Position+1;
		}
		Select_Plot(Last_Position,Position);
	}
    if(key == 6) // 确定
    {
		
		now_state_1 = KEY_PLANT;
    }

}


//显示游标位置通用画面
static void Show_Position(u8 Position_1,u8 code *DData)
{
	switch(Position_1)
	{
		case 11:LCD12864_Show_ImageTry1(DData); break;
		case 21:LCD12864_Show_ImageTry2(DData); break;
		case 31:LCD12864_Show_ImageTry3(DData); break;
		case 12:LCD12864_Show_ImageTry11(DData);break;
		case 22:LCD12864_Show_ImageTry22(DData);break;
		case 32:LCD12864_Show_ImageTry33(DData);break;
	}
}

//选择植物类型按键
static void Type_Plant_Key(u8 key)
{
    if(key == 5)//左选
    {
        if(Type_Plant > 0) Type_Plant--;
		switch(Type_Plant)
		{
			case 1:Show_Position(Position,IMG_DATA_Position); break;//1选择植物
			case 0:Show_Position(Position,IMG_DATA2_Plant); break;//空置
			case 2:Show_Position(Position,IMG_DATA_Pototas); break;//2选择土豆
		}
    }
    if(key == 7)//右选
    {
        if(Type_Plant < 2) Type_Plant++;
		switch(Type_Plant)
		{
			case 1:Show_Position(Position,IMG_DATA_Position); break;
			case 0:Show_Position(Position,IMG_DATA2_Plant); break;
			case 2:Show_Position(Position,IMG_DATA_Pototas); break;
		}
    }
    if(key == 6)
    {
		switch(Type_Plant)
		{
			case 1:Show_Position(Position,IMG_DATA_Position);Set_Plot_State(Position,EMPTY); break;
			case 0:Show_Position(Position,IMG_DATA2_Plant); Set_Plot_State(Position,PEA);break;
			case 2:Show_Position(Position,IMG_DATA_Pototas);Set_Plot_State(Position,POTATO); break;
		}
        now_state_1 = KEY_CHOOSE;
    }
}

//种植地块选择
void Select_Plot(u8 Last_Position,u8 Position)
{
	if(Get_Plot_State(Last_Position)==0)
	{
		Show_Position(Last_Position,IMG_DATA_Empty);
	}
	if(Get_Plot_State(Position)==0)
	{
		Show_Position(Position,IMG_DATA_Position);
	}

    
}
